/*
 * Copyright (c) 2021 The ZMK Contributors
 *
 * SPDX-License-Identifier: MIT
 */

#include <zephyr/dt-bindings/gpio/nordic-nrf-gpio.h>

/ {
    vbatt0: vbatt0 {
        compatible = "zmk,battery-voltage-divider";
        io-channels = <&adc 1>; // P0.03
        output-ohms = <2000000>;
        full-ohms = <(1000000 + 2000000)>;
        power-gpios = <&gpio0 2 GPIO_ACTIVE_HIGH>; // P0.02
    };

    hhkb_pro2_connector: hhkb_pro2_connector {
        compatible = "zmk,hhkb-pro2-header";
        #gpio-cells = <2>;
        gpio-map-mask = <0xffffffff 0xffffffc0>;
        gpio-map-pass-thru = <0 0x3f>;
        gpio-map = <0 0 &gpio0 31 NRF_GPIO_DRIVE_S0H1>,
                   <1 0 &gpio0 4 0>,
                   <2 0 &gpio0 5 0>,
                   <3 0 &gpio0 22 0>,
                   <4 0 &gpio0 7 0>,
                   <5 0 &gpio1 9 0>,
                   <6 0 &gpio0 12 0>,
                   <7 0 &gpio0 23 0>,
                   <8 0 &gpio0 21 0>,
                   <9 0 &gpio0 19 0>;
    };
};
## config/boards/arm/whkb_pro2/Kconfig.board
```kconfig
# Copyright (c) 2023 Kan-Ru Chen
# SPDX-License-Identifier: MIT

config BOARD_WHKB_PRO2
    bool "WHKB Pro2"
    depends on SOC_NRF52840_QIAA
```

## config/boards/arm/whkb_pro2/Kconfig.defconfig
```kconfig
# Copyright (c) 2023 Kan-Ru Chen
# SPDX-License-Identifier: MIT

if BOARD_WHKB_PRO2

config ZMK_KEYBOARD_NAME
    default "WHKB Pro2"

config BOARD
    default "whkb_pro2"

if USB_DEVICE_STACK

config USB_NRFX
    default y

endif # USB_DEVICE_STACK

config BT_CTLR
    default BT

config ZMK_BLE
    default y

config ZMK_USB
    default y

endif # BOARD_WHKB_PRO2
```

## config/boards/shields/custom_pro2/Kconfig.shield
```kconfig
config SHIELD_CUSTOM_PRO2
    def_bool $(shields_list_contains,custom_pro2)
    depends on KSCAN_HHKB_PRO2
```

## config/boards/shields/hhkb_pro2/Kconfig.shield
```kconfig
config SHIELD_HHKB_PRO2
    def_bool $(shields_list_contains,hhkb_pro2)
    depends on KSCAN_HHKB_PRO2
```

## config/dts/bindings/hhkb_pro2/zmk,hhkb-pro2-header.yaml
```yaml
# Copyright (c) 2022 Kan-Ru Chen
# SPDX-License-Identifier: MIT

description: |
  Pins exposed on HHKB Pro2 daughter board header.

  This binding provides a nexus mapping for the 13 pin header found
  on the HHKB Pro2 daugther board.

  Header | Pin | name
  -------+-----+-----
  1        P0    VCC
  2        P0    VCC
  3        P1    KEY
  4        P2    HYS
  5        P3    BIT0
  6        P4    BIT1
  7        P5    BIT2
  8        P6    BIT3
  9        P7    BIT4
  10       P8    BIT5
  11       P9    STROBE
  12       P10   GND
  13       P10   GND

compatible: "zmk,hhkb-pro2-header"

include: [base.yaml, gpio-nexus.yaml]
```

## config/dts/bindings/kscan/zmk,kscan-gpio-topre.yaml
```yaml
# Copyright (c) 2022 Kan-Ru Chen
# SPDX-License-Identifier: MIT

description: GPIO topre keyboard controller

compatible: "zmk,kscan-gpio-topre"

include: kscan.yaml

properties:
  gpios:
    type: phandle-array
    required: true
  matrix-relax-us:
    type: int
    default: 6
  adc-read-settle-us:
    type: int
    default: 5
  active-polling-interval-ms:
    type: int
    default: 8
  idle-polling-interval-ms:
    type: int
    default: 30
  sleep-polling-interval-ms:
    type: int
    default: 3000
```

## config/dts/bindings/kscan/zmk,kscan-hhkb-pro2.yaml
```yaml
# Copyright (c) 2022 Kan-Ru Chen
# SPDX-License-Identifier: MIT

description: HHKB Pro2 keyboard controller

compatible: "zmk,kscan-hhkb-pro2"

include: kscan.yaml

properties:
  gpios:
    type: phandle-array
    required: true
  matrix-warm-up-ms:
    type: int
    default: 5
  matrix-relax-us:
    type: int
    default: 6
  adc-read-settle-us:
    type: int
    default: 5
  active-polling-interval-ms:
    type: int
    default: 3
  idle-polling-interval-ms:
    type: int
    default: 35
  sleep-polling-interval-ms:
    type: int
    default: 3000
```

## config/dts/bindings/pm/zmk,pm-wake-sensor.yaml
```yaml
# Copyright (c) 2022 Kan-Ru Chen
# SPDX-License-Identifier: MIT

description: GPIO button to wake up a nRF52 board

compatible: "zmk,pm-wake-sensor"

properties:
  power-gpios:
    type: phandle-array
    required: false
  sensor-gpios:
    type: phandle-array
    required: true
```

## config/zephyr/Kconfig
```kconfig
config KSCAN_HHKB_PRO2
    bool "HHKB Pro2 daugther board driver"
    default y

config PM_WAKE_SENSOR
    bool
    default n
```

/*
 * Copyright (c) 2022, 2023 Kan-Ru Chen
 *
 * SPDX-License-Identifier: MIT
 */

#include <zephyr/dt-bindings/gpio/nordic-nrf-gpio.h>

/ {
    model = "custom_pro2";
    compatible = "kanru,hhkb_pro2";

    hhkb_pro2_connector: hhkb_pro2_connector {
        compatible = "zmk,hhkb-pro2-header";
        #gpio-cells = <2>;
        gpio-map-mask = <0xffffffff 0xffffffc0>;
        gpio-map-pass-thru = <0 0x3f>;
        gpio-map = <0 0 &gpio1 6 NRF_GPIO_DRIVE_S0H1>,
                   <1 0 &gpio1 4 0>,
                   <2 0 &gpio0 11 0>,
                   <3 0 &gpio1 0 0>,
                   <4 0 &gpio0 24 0>,
                   <5 0 &gpio0 22 0>,
                   <6 0 &gpio0 20 0>,
                   <7 0 &gpio0 17 0>,
                   <8 0 &gpio0 8 0>,
                   <9 0 &gpio0 6 0>;
    };
};